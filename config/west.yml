## config/west.yml
```yaml
manifest:
  remotes:
    - name: zmkfirmware
      url-base: https://github.com/zmkfirmware

    - name: fergy654
      url-base: https://github.com/fergy654

  projects:
    - name: zmk
      remote: zmkfirmware
      revision: v0.3
      import: app/west.yml

    - name: zmk-driver-azoteq-iqs5xx
      remote: fergy654
      revision: fix-setup-retry
      
  self:
    path: config
```
