#include "lily58.dtsi"
#include <input/processors.dtsi>
#include <dt-bindings/zmk/input_transform.h>

&kscan0 {
    col-gpios
        = <&pro_micro 19 GPIO_ACTIVE_HIGH>
        , <&pro_micro 18 GPIO_ACTIVE_HIGH>
        , <&pro_micro 15 GPIO_ACTIVE_HIGH>
        , <&pro_micro 14 GPIO_ACTIVE_HIGH>
        , <&pro_micro 16 GPIO_ACTIVE_HIGH>
        , <&pro_micro 10 GPIO_ACTIVE_HIGH>
        ;
};

&tps43_listener {
    status = "okay";
    // As mounted, the trackpad reports X mirrored, so invert X for movement and scrolling.
    input-processors
        = <&zip_xy_transform INPUT_TRANSFORM_X_INVERT>
        , <&zip_scroll_transform INPUT_TRANSFORM_X_INVERT>
        ;
};
